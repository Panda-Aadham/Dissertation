## esp32-firmware/esp32-tflm-test/sdkconfig.defaults
```kconfig
# Disable C++ exceptions and RTTI to save space
CONFIG_COMPILER_CXX_EXCEPTIONS=n
CONFIG_COMPILER_CXX_RTTI=n

# Enable PSRAM for larger models
CONFIG_SPIRAM=y
CONFIG_SPIRAM_USE_CAPS_ALLOC=y
CONFIG_SPIRAM_USE_MALLOC=y

# Increase main stack size
CONFIG_ESP_MAIN_TASK_STACK_SIZE=8192

# Optimize for performance
CONFIG_COMPILER_OPTIMIZATION_PERF=y

# Enable ESP Timer
CONFIG_ESP_TIMER_SUPPORTS_ISR_DISPATCH_METHOD=y

# Increase heap size
CONFIG_ESP_MAIN_TASK_AFFINITY_CPU0=y
```
